## config/west.yml
```yaml
manifest:
  remotes:
    - name: zmkfirmware
      url-base: https://github.com/zmkfirmware
    - name: sekigon-gonnoc
      url-base: https://github.com/sekigon-gonnoc
    - name: caksoylar
      url-base: https://github.com/caksoylar
    - name: 4mplelab
      url-base: https://github.com/4mplelab
  projects:
    - name: zmk
      remote: zmkfirmware
      revision: v0.2.0
      import: app/west.yml
    - name: zmk-driver-paw3222
      remote: sekigon-gonnoc
      revision: 9c2b9a1
    - name: zmk-rgbled-widget
      remote: caksoylar
      revision: 6d2f0c7
    - name: zmk-feature-charge-indicator
      remote: 4mplelab
      revision: 3a1f8d2
  self:
    path: config
```
